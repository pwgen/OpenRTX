## platform/targets/ttwrplus/ttwrplus_defconfig
```kconfig
CONFIG_SOC_SERIES_ESP32S3=y
CONFIG_DISPLAY=y
CONFIG_SSD1306=y
CONFIG_THREAD_STACK_INFO=y
CONFIG_DYNAMIC_THREAD=y
CONFIG_DYNAMIC_THREAD_STACK_SIZE=4096
CONFIG_DYNAMIC_THREAD_PREFER_POOL=y
CONFIG_DYNAMIC_THREAD_POOL_SIZE=4
CONFIG_COMMON_LIBC_MALLOC=y
CONFIG_COMMON_LIBC_MALLOC_ARENA_SIZE=131072
CONFIG_INPUT=y
CONFIG_INPUT_GPIO_KEYS=y
CONFIG_SENSOR=y
CONFIG_SERIAL=y
CONFIG_UART_INTERRUPT_DRIVEN=y
CONFIG_UART_USE_RUNTIME_CONFIGURE=y
CONFIG_ASSERT=y
CONFIG_SPI=y
CONFIG_LED_STRIP=y
CONFIG_WS2812_STRIP=y
CONFIG_WS2812_STRIP_SPI=y
CONFIG_PICOLIBC_IO_FLOAT=y
CONFIG_POSIX_API=y
CONFIG_FLASH=y
CONFIG_FLASH_MAP=y
CONFIG_FLASH_PAGE_LAYOUT=y
CONFIG_SOC_FLASH_ESP32=y
CONFIG_MPU_ALLOW_FLASH_WRITE=y

CONFIG_BOOT_BANNER=n
CONFIG_SHELL=y
CONFIG_FILE_SYSTEM_SHELL=y
CONFIG_CONSOLE=y
CONFIG_UART_CONSOLE=y
CONFIG_GPIO=y
CONFIG_CLOCK_CONTROL=y

CONFIG_DISK_ACCESS=y
CONFIG_FILE_SYSTEM=y
CONFIG_FILE_SYSTEM_LITTLEFS=y
CONFIG_FS_LITTLEFS_LOOKAHEAD_SIZE=4096

CONFIG_USB_DEVICE_STACK=y
CONFIG_USB_DEVICE_PRODUCT="T-TWR Radio"
CONFIG_SHELL_BACKEND_SERIAL_CHECK_DTR=y
CONFIG_UART_LINE_CTRL=y
CONFIG_SHELL_BACKEND_SERIAL_INIT_PRIORITY=51
CONFIG_USB_DEVICE_INITIALIZE_AT_BOOT=y
```
